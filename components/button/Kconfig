## components/button/Kconfig
```kconfig
menu "Button Configuration"

config BUTTON_PIN
    int "Button GPIO Pin"
    default 9  # Default to GPIO_NUM_9 for generic boards
    help
        Select the GPIO pin number used for the button.

endmenu
```

## main/Kconfig.projbuild
```kconfig
menu "Radar device configuration"

config LD2450_TX_PIN
    int "LD2450 TX Pin"
    default 21
    help
        Define the TX pin number for the LD2450 Radar Sensor.

config LD2450_RX_PIN
    int "LD2450 RX Pin"
    default 20
    help
        Define the RX pin number for the LD2450 Radar Sensor.

config LD1125_TX_PIN
    int "LD1125 TX Pin"
    default 2
    help
        Define the TX pin number for the LD1125 Radar Sensor.

config LD1125_RX_PIN
    int "LD1125 RX Pin"
    default 3
    help
        Define the RX pin number for the LD1125 Radar Sensor.


config BUTTON_PIN
    int "Button GPIO Pin"
    default 9  # Default to GPIO_NUM_9 for generic boards
    help
        Select the GPIO pin number used for the button.

endmenu
```

## sdkconfig.defaults
```kconfig
# Target + flash
CONFIG_IDF_TARGET="esp32c3"
CONFIG_ESPTOOLPY_FLASHSIZE_4MB=y
CONFIG_ESPTOOLPY_FLASHSIZE="4MB"

# Custom dual-OTA partition table (see partitions.csv).
CONFIG_PARTITION_TABLE_CUSTOM=y
CONFIG_PARTITION_TABLE_CUSTOM_FILENAME="partitions.csv"

# OTA rollback: a freshly-OTA'd image boots PENDING_VERIFY; app_main calls
# esp_ota_mark_app_valid_cancel_rollback() once Wi-Fi is up. Any failure
# (panic, Wi-Fi never associates) reboots into the previous slot.
CONFIG_BOOTLOADER_APP_ROLLBACK_ENABLE=y

# Main task: app_main only wires things up and spawns tasks.
CONFIG_ESP_MAIN_TASK_STACK_SIZE=6144

# C++: components use std::function / std::regex.
CONFIG_COMPILER_CXX_EXCEPTIONS=y
CONFIG_COMPILER_CXX_RTTI=y
```
